## Documentation/devicetree/bindings/mfd/palmas.txt
```
Texas Instruments Palmas family

The Palmas familly are Integrated Power Management Chips.
These chips are connected to an i2c bus.


Required properties:
- compatible : Must be "ti,palmas";
  For Integrated power-management in the palmas series, twl6035, twl6037,
  tps65913
- interrupts : This i2c device has an IRQ line connected to the main SoC
- interrupt-controller : Since the palmas support several interrupts internally,
  it is considered as an interrupt controller cascaded to the SoC one.
- #interrupt-cells = <1>;
- interrupt-parent : The parent interrupt controller.

Optional node:
- Child nodes contain in the palmas. The palmas family is made of several
  variants that support a different number of features.
  The child nodes will thus depend of the capability of the variant.
- mux_pad1 if a value is given it will be used for the pad1 mux
- mux_pad2 if a value us given it will be used for the pad2 mux
- power_ctrl if a value is given it will be written to the POWER_CTRL register

Example:
/*
 * Integrated Power Management Chip Palmas
 */
palmas@48 {
    compatible = "ti,palmas";
    reg = <0x48>;
    interrupts = <39>; /* IRQ_SYS_1N cascaded to gic */
    interrupt-controller;
    #interrupt-cells = <1>;
    interrupt-parent = <&gic>;
    #address-cells = <1>;
    #size-cells = <0>;

	ti,mux_pad1 = <0x00>;
	ti,mux_pad2 = <0x00>;
	ti,power_ctrl = <0x03>;

	palmas_pmic {
		compatible = "ti,palmas_pmic";
		regulators {
			smps12_reg: smps12 {
				regulator-min-microvolt = < 600000>;
                regulator-max-microvolt = <1500000>;
				regulator-always-on;
				regulator-boot-on;
                ti,warm_sleep = <0>;
                ti,roof_floor = <0>;
                ti,mode_sleep = <0>;
                ti,warm_reset = <0>;
                ti,tstep = <0>;
                ti,vsel = <0>;
			};
		};
		ti,ldo6_vibrator = <0>;
	};

    palmas_rtc {
        compatible = "ti,palmas_rtc";
        interrupts = <8 9>;
        reg = <0>;
    };
};
```

## Documentation/devicetree/bindings/mfd/ti_am335x_tscadc.txt
```
Texas Instruments - TSC / ADC multi-functional device

ti_tscadc is a multi-function device with touchscreen and ADC on chip.
This document describes the binding for mfd device.

Required properties:
- compatible: "ti,ti-tscadc"
- reg: Specifies the address of MFD block
- interrupts: IRQ line connected to the main SoC
- interrupt-parent: The parent interrupt controller

Optional properties:
- ti,hwmods: Hardware information related to TSC/ADC MFD device

Sub-nodes:
Device			Description
------			-----------
tsc			Touchscreen
adc			Analog to digital converter

Sub-node device required properties:
tsc:
- ti,wires:  4/5/8 wire touchscreen support on the platform.
- ti,x-plate-resistance: X plate resistance.
- ti,steps-to-configure: A step is configured to read a single co-ordinate value,
			can be applied more number of times for better results.
- ti,wire-config: Order for connecting wires on touchscreen.

adc:
- ti,adc-channels: Number of ADC channels used.

Example:

	tscadc: tscadc@44e0d000 {
		compatible = "ti,ti-tscadc";
		reg = <0x44e0d000 0x1000>;

		interrupt-parent = <&intc>;
		interrupts = <16>;
		ti,hwmods = "adc_tsc";

		tsc {
			ti,wires = <4>;
			ti,x-plate-resistance = <200>;
			ti,steps-to-configure = <5>;
			ti,wire-config = <0x00 0x11 0x22 0x33>;
		};

		adc {
			ti,adc-channels = <4>;
		};
	};
```

## Documentation/devicetree/bindings/pinctrl/pinctrl-simple.txt
```
Generic simple device tree based pinctrl driver

Required properties:
- compatible :  one of:
	- "pinctrl-simple"
	- "ti,omap2420-padconf"
	- "ti,omap2430-padconf"
	- "ti,omap3-padconf"
	- "ti,omap4-padconf"
- reg : offset and length of the register set for the mux registers
- #pinctrl-cells : width of the pinctrl array, currently only 2 is supported
- pinctrl-simple,register-width : pinmux register access width
- pinctrl-simple,function-mask : mask of allowed pinmux function bits
- pinctrl-simple,function-off : function off mode for disabled state
- pinctrl-simple,pinconf-mask : mask of allowed pinconf bits

This driver uses the common pinctrl bindings as specified in
pinctrl-bindings.txt document in this directory. The common bindings are used
to specify the client device states using pinctrl-0 and pinctrl-names entries.

This driver supports parsing one or more pinctrl functions as the subnodes of
the pinctrl driver entry. One or more registers can be specified for each
function, see uart2 and uart3 examples below. If you are concerned about boot
time, parsing multiple registers in a single function is slightly faster.

For setting all static board specific pins, see the pinmux_board_pins example
below. If you are concerned about the boot time, set up the static pins in
the bootloader, and only set up selected pins as device tree entries.

This driver assumes currently that there is one register for each pin. If you
have some pins with more complicated configuration, you can set up a separate
hardware specific driver for those pins.

Example:

/* SoC common file, such as omap4.dtsi */
omap4_pmx_core: pinmux@4a100040 {
	compatible = "ti,omap4-padconf";
	reg = <0x4a100040 0x0196>;
	#address-cells = <1>;
	#size-cells = <0>;
	#pinctrl-cells = <2>;
	pinctrl-simple,register-width = <16>;
	pinctrl-simple,function-mask = <0x7>;
	pinctrl-simple,function-off = <0xffffffff>;
	pinctrl-simple,pinconf-mask = <0xfff8>;
};

omap4_pmx_wkup: pinmux@4a31e040 {
	compatible = "ti,omap4-padconf";
	reg = <0x4a31e040 0x0038>;
	#address-cells = <1>;
	#size-cells = <0>;
	#pinctrl-cells = <2>;
	pinctrl-simple,register-width = <16>;
	pinctrl-simple,function-mask = <0x7>;
	pinctrl-simple,function-off = <0xffffffff>;
	pinctrl-simple,pinconf-mask = <0xfff8>;
};


/* board specific .dts file, such as omap4-sdp.dts */
&omap4_pmx_core {

	/*
	 * map all board specific static pins enabled by the pinctrl driver
	 * itself during the boot (or just set them up in the bootloader)
	 */
	pinctrl-names = "default";
	pinctrl-0 = <&board_pins>;

	board_pins: pinmux_board_pins {
		board_static_pins {
			pinctrl-simple,cells = <
				0x6c 0xf	/* CSI21_DX3 OMAP_PIN_OUTPUT | OMAP_MUX_MODE7 */
				0x6e 0xf	/* CSI21_DY3 OMAP_PIN_OUTPUT | OMAP_MUX_MODE7 */
				0x70 0xf	/* CSI21_DX4 OMAP_PIN_OUTPUT | OMAP_MUX_MODE7 */
				0x72 0xf	/* CSI21_DY4 OMAP_PIN_OUTPUT | OMAP_MUX_MODE7 */
			>;
		};
	};


	/* map all uart2 pins as a single function */
	uart2_pins: pinmux_uart2_pins {
		uart2_pins {
			pinctrl-simple,cells = <
				0xd8 0x118	/* UART2_CTS OMAP_PIN_INPUT_PULLUP | OMAP_MUX_MODE0 */
				0xda 0		/* UART2_RTS OMAP_PIN_OUTPUT | OMAP_MUX_MODE0 */
				0xdc 0x118	/* UART2_RX OMAP_PIN_INPUT_PULLUP | OMAP_MUX_MODE0 */
				0xde 0		/* UART2_TX OMAP_PIN_OUTPUT | OMAP_MUX_MODE0 */
			>;
		};
	};

	/* map all uart3 pins as separate functions */
	uart3_pins: pinmux_uart3_pins {
		uart3_cts_rctx.uart3_cts_rctx {
			pinctrl-simple,cells = <0x100 0x118>;	/* OMAP_PIN_INPUT_PULLUP | OMAP_MUX_MODE0 */
                };

		uart3_rts_sd.uart3_rts_sd {
			pinctrl-simple,cells = <0x102 0>;	/* OMAP_PIN_OUTPUT | OMAP_MUX_MODE0 */
		};

		uart3_rx_irrx.uart3_rx_irrx {
			pinctrl-simple,cells = <0x104 0x100>;	/* OMAP_PIN_INPUT | OMAP_MUX_MODE0 */
		};

		uart3_tx_irtx.uart3_tx_irtx {
			pinctrl-simple,cells = <0x106 0>;	/* OMAP_PIN_OUTPUT | OMAP_MUX_MODE0 */
		};
	};
};

&uart2 {
       pinctrl-names = "default";
       pinctrl-0 = <&uart2_pins>;
};

&uart3 {
       pinctrl-names = "default";
       pinctrl-0 = <&uart3_pins>;
};
```

## Documentation/devicetree/bindings/sound/davinci-evm-audio.txt
```
* Texas Instruments SoC audio setups with TLV320AIC3X Codec

Required properties:
- compatible : "ti,davinci-evm-audio"
- ti,model : The user-visible name of this sound complex.
- ti,audio-routing : A list of the connections between audio components.
  Each entry is a pair of strings, the first being the connection's sink,
  the second being the connection's source. Valid names for sources and
  sinks are the codec's pins, and the jacks on the board:

  Codec pins:

  * MIC3L
  * MIC3R
  * LINE1L
  * LINE2L
  * LINE1R
  * LINE2R

  Board connectors:

  * Headphone Jack
  * Line Out
  * Mic Jack

- ti,mcasp-controller : The phandle of the McASP controller
- ti,audio-codec : The phandle of the TLV320AIC3x audio codec
- ti,codec-clock-rate : The Codec Clock rate (in Hz) applied to the Codec

- dai-data		: A list of DAI data used by SOC code to register
			  DAI, Codecs platform.
			  The string index "should" be as shown below.
dai-data =
"<DAI Name>", 		"<DAI Stream Name>",
"<CODEC DAI Name>",	"<true if evm_aic3x_init is required, else false>",
"<evm ops required (evm_ops or evm_spdif_ops)>";

Here fields
"<DAI Name>"		: used to indicate the DAI Name
"<DAI Stream Name>"	: used to indicate the Stream Name
"<CODEC DAI Name>"	: used to bind the link between Codec DAI and ASOC DAI

Machine related options
"<true/false>"		: Whether the machine specific initialization
			: evm_aic3x_init() is required

"<evm ops required>"	: Which hardware ops function is to be used.
			: (evm_ops or evm_spdif_ops)


Example:

sound {
	compatible = "ti,davinci-evm-audio";
	ti,model = "DA830 EVM";
	ti,audio-codec = <&tlv320aic3x>;
	ti,mcasp-controller = <&mcasp1>;
	ti,codec-clock-rate = <12000000>;
	dai-data =
		"TLV320AIC3X", 		"AIC3X",
		"tlv320aic3x-hifi",	"true",
		"evm-ops";
};
```
